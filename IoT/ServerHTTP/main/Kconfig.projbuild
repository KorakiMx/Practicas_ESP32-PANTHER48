## IoT/ServerHTTP/main/Kconfig.projbuild
```kconfig
menu "Example Configuration"

    config ESP_WIFI_SSID
        string "Nombre De La Red"
        default "NOMBRE DE LA RED"
        help
            SSID (network name) for the example to connect to.

    config ESP_WIFI_PASSWORD
        string "Contraseña del WIFI"
        default "CONTRASEÑA"
        help
            WiFi password (WPA or WPA2) for the example to use.

    config ESP_MAXIMUM_RETRY
        int " INTENTOS MAXIMOS"
        default 5
        help
            Set the Maximum retry to avoid station reconnecting to the AP unlimited when the AP is really inexistent.
endmenu
```
